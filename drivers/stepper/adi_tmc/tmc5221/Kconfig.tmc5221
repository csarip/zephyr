## drivers/stepper/adi_tmc/tmc5221/Kconfig.tmc5221
```kconfig
# SPDX-FileCopyrightText: Copyright (c) 2025 Cherrence Sarip <Cherrence.sarip@analog.com>
# SPDX-License-Identifier: Apache-2.0

config STEPPER_ADI_TMC5222
	bool "Activate trinamic tmc5222 stepper driver"
	depends on DT_HAS_ADI_TMC5222_ENABLED
	select SPI
	select STEPPER_ADI_TMC_SPI
	default y
	help
	  Low-level SPI driver for TMC5222 stepper motor controller.
	  Provides register read/write access via SPI interface.
	  Uses the common Trinamic SPI bus abstraction layer.
```

## drivers/stepper/adi_tmc/tmc6460/Kconfig.tmc6460
```kconfig
# SPDX-FileCopyrightText: Copyright (c) 2026 Cherrence Sarip <cherrence.sarip@analog.com>
# SPDX-License-Identifier: Apache-2.0

config STEPPER_ADI_TMC6460
	bool "Activate Trinamic TMC6460 driver"
	depends on DT_HAS_ADI_TMC6460_ENABLED
	depends on SPI
	default y
	help
	  Enable support for the Analog Devices / Trinamic TMC6460
	  motor controller accessed via SPI. The TMC6460 uses 48-bit
	  (6-byte) SPI datagrams with a 16-bit address space.
```
