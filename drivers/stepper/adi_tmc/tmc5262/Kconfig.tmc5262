## dts/bindings/stepper/adi/adi,tmc5262-base.yaml
```yaml
# SPDX-FileCopyrightText: Copyright (c) 2026 Analog Devices, Inc.
# SPDX-License-Identifier: Apache-2.0

description: |
  Common properties of the ADI TMC5262, TMC2262 and TMC3241 stepper motor drivers.

  This is the base binding of the unified TMC5262 driver. Do not use it directly, use
  adi,tmc5262.yaml, adi,tmc2262.yaml or adi,tmc3241.yaml. Each variant binding adds the
  properties that only exist on that device (chopper fields, step source, StealthChop+,
  current range table, DO sources).

  The chip node is the SPI device (parent). It can have these child nodes:

  - adi,tmc5262-stepper-driver: stepper API (enable, microstep, events). On all variants.
    On the TMC2262, and on the other variants when STEP/DIR is the step source, point
    the "stepper-driver" property of a zephyr,gpio-step-dir-stepper-ctrl node to it.
  - adi,tmc5262-stepper-ctrl: stepper_ctrl API on the internal ramp generator
    (TMC5262 and TMC3241 only, step-source = "ramp-generator").

  The STEP and DIR pins are owned by the zephyr,gpio-step-dir-stepper-ctrl node, not by
  the chip node.

include:
  - name: adi,trinamic-stallguard.yaml
    property-allowlist:
      - stallguard2-threshold
  - name: adi,trinamic-ramp-generator.yaml
    property-allowlist:
      - tcoolthrs
      - thigh
      - tpowerdown

properties:
  sleepn-gpios:
    type: phandle-array
    description: |
      SLEEPN pin. Use GPIO_ACTIVE_HIGH: the logical level 1 is "awake" (pin high).
      The driver pulses the pin low for at least 50 us for a hardware reset and holds
      it low in sleep mode. Omit if the board ties SLEEPN high; sleep mode and the
      hardware reset are then not available.

  drv-enn-gpios:
    type: phandle-array
    description: |
      DRV_ENN pin (power stage enable, active low). Use GPIO_ACTIVE_LOW so that the
      logical level 1 enables the power stage. The driver keeps the power stage disabled
      until stepper_enable() is called. If omitted (pin tied low) the driver disables
      the outputs with CHOPCONF.TOFF = 0 instead.

  do0-gpios:
    type: phandle-array
    description: |
      DO0 diagnostic output, used as interrupt input. DO0 is held low during reset.
      If neither do0-gpios nor do1-gpios is provided, events are polled at
      CONFIG_STEPPER_ADI_TMC5262_EVENT_POLL_INTERVAL_MS.

  do1-gpios:
    type: phandle-array
    description: DO1 diagnostic output, used as interrupt input.

  clock-source:
    type: string
    default: internal
    enum:
      - internal
      - external
    description: |
      System clock source: the internal 16 MHz oscillator or an external clock on pin CLK.
      The ramp generator, which runs on the PLL output, always uses 16 MHz for unit
      conversion.

  clock-frequency:
    type: int
    default: 16000000
    description: |
      Frequency of the external clock in Hz when clock-source is "external". Must be
      1 MHz to 32 MHz in 1 MHz steps. CLOCK_DIVIDER is set to MHz - 1. Ignored for the
      internal oscillator.

  current-range-scale-percent:
    type: int
    default: 100
    enum:
      - 25
      - 50
      - 75
      - 100
    description: |
      DRV_CONF.CURRENT_RANGE_SCALE. A value below 100 requires the lowest current range.

  irun:
    type: int
    default: 240
    description: |
      IHOLD_IRUN.IRUN, motor run current scaler 0..255 (reset default 240). Choose
      current-range-ma so that the normal IRUN is 128 to 255.
    min: 0
    max: 255

  ihold:
    type: int
    default: 64
    description: IHOLD_IRUN.IHOLD, standstill current scaler 0..255 (reset default 64).
    min: 0
    max: 255

  iholddelay:
    type: int
    default: 7
    description: |
      IHOLD_IRUN.IHOLDDELAY, delay per current reduction step in multiples of 2^11 clocks.
    min: 0
    max: 255

  irundelay:
    type: int
    default: 4
    description: |
      IHOLD_IRUN.IRUNDELAY, delay per current increment step in multiples of 64 clocks.
    min: 0
    max: 15

  slope-control:
    type: int
    default: 3
    description: |
      DRV_CONF.SLOPE_CONTROL: 0 = 100 V/us, 1 = 200 V/us, 2 = 400 V/us, 3 = 800 V/us.
    enum:
      - 0
      - 1
      - 2
      - 3

  invert-direction:
    type: boolean
    description: |
      GCONF.shaft: invert the motor direction (STEP/DIR operation only; rejected at run
      time if the ramp generator is the step source).

  stop-enable:
    type: boolean
    description: GCONF.stop_enable, ENCA acts as emergency stop for the sequencer.

  ov-output:
    type: boolean
    description: |
      GCONF.OV_nN, use ENCN as (open-drain, high active) overvoltage output instead of
      the encoder N channel. Cannot be combined with encoder-n-channel.

  encoder-n-channel:
    type: boolean
    description: |
      The application uses the N channel of the incremental encoder. Used to reject the
      combination with ov-output at build time.

  multistep-filt:
    type: int
    default: 1
    enum:
      - 0
      - 1
    description: |
      GCONF.multistep_filt, step input filtering for external step sources (reset
      default 1).

  small-hysteresis:
    type: int
    default: 1
    enum:
      - 0
      - 1
    description: |
      GCONF.small_hysteresis, 1 = 1/32 hysteresis for step frequency comparison
      (recommended with the ramp generator), 0 = 1/16 (reset default 1).

  fast-standstill:
    type: int
    default: 0
    enum:
      - 0
      - 1
    description: |
      GCONF.fast_standstill, 1 = standstill after 2^18 clocks, 0 = 2^20 clocks.

  dedge:
    type: boolean
    description: |
      CHOPCONF.dedge, both STEP edges are active. Also reported to a
      zephyr,gpio-step-dir-stepper-ctrl through the stepper-driver child.

  intpol:
    type: int
    default: 1
    enum:
      - 0
      - 1
    description: |
      CHOPCONF.intpol, interpolate the microstep resolution to 256 microsteps (useful
      for STEP/DIR operation). The default 1 is the reset value of the register.

  stallguard2-filter:
    type: boolean
    description: COOLCONF.sfilt, StallGuard2 filtering for low speeds.

  do0-sources:
    type: string-array
    description: |
      Sources routed to DO0 (DO_CONF). The valid values are defined by the variant binding.

  do1-sources:
    type: string-array
    description: |
      Sources routed to DO1 (DO_CONF). The valid values are defined by the variant binding.

  do0-push-pull:
    type: boolean
    description: |
      DO0 is a push-pull output (default: open collector, active low).

  do0-active-high:
    type: boolean
    description: |
      DO0 push-pull polarity is high active. Default is low active, which is the reset
      value of DO_CONF.do0_invPP.

  do1-push-pull:
    type: boolean
    description: |
      DO1 is a push-pull output (default: open collector, active low).

  do1-active-high:
    type: boolean
    description: |
      DO1 push-pull polarity is high active. Default is low active, which is the reset
      value of DO_CONF.do1_invPP.
```

## dts/bindings/stepper/adi/adi,tmc5262-plus.yaml
```yaml
# SPDX-FileCopyrightText: Copyright (c) 2026 Analog Devices, Inc.
# SPDX-License-Identifier: Apache-2.0

description: |
  Optional properties of the StealthChop+, StallGuard+, CoolStep+, uDcStep and coil measurement
  features of the TMC5262 and TMC2262 (not available on the TMC3241). Every property is
  optional; the default is the reset value of the datasheet register, so a node without any of
  them leaves the features at their power-up configuration. This file is included by
  adi,tmc5262.yaml and adi,tmc2262.yaml only: on the TMC3241 the properties do not exist and
  using one fails the devicetree build.

properties:
  cur-i:
    type: int
    default: 10
    description: CURRENT_PI_REG.CUR_I, integral gain of the StealthChop+ current regulator.
    min: 0
    max: 1023

  cur-p:
    type: int
    default: 64
    description: CURRENT_PI_REG.CUR_P, proportional gain of the StealthChop+ current regulator.
    min: 0
    max: 4095

  angle-i:
    type: int
    default: 20
    description: ANGLE_PI_REG.ANGLE_I, integral gain of the StealthChop+ angle regulator.
    min: 0
    max: 1023

  angle-p:
    type: int
    default: 50
    description: ANGLE_PI_REG.ANGLE_P, proportional gain of the StealthChop+ angle regulator.
    min: 0
    max: 4095

  cur-pi-limit:
    type: int
    default: 4095
    description: CUR_ANGLE_LIMIT.CUR_PI_LIMIT, limit of the current regulator output.
    min: 0
    max: 4095

  angle-pi-limit:
    type: int
    default: 256
    description: CUR_ANGLE_LIMIT.ANGLE_PI_LIMIT, limit of the angle regulator output.
    min: 0
    max: 1023

  angle-lower-i-limit:
    type: int
    default: 256
    description: ANGLE_LOWER_LIMIT.ANGLE_LOWER_I_LIMIT, lower limit of the angle integrator.
    min: 0
    max: 1023

  sgp-thrs:
    type: int
    default: 0
    description: SGP_CONF.SGP_THRS, StallGuard+ stall threshold.
    min: 0
    max: 511

  sgp-filt-en:
    type: boolean
    description: SGP_CONF.sgp_filt_en, enable the StallGuard+ result filter.

  sgp-low-vel-freeze:
    type: int
    default: 0
    enum:
      - 0
      - 1
    description: SGP_CONF.sgp_low_vel_freeze.

  sgp-clear-cur-pi:
    type: int
    default: 1
    enum:
      - 0
      - 1
    description: SGP_CONF.sgp_clear_cur_pi (reset value 1).

  sgp-low-vel-slope:
    type: int
    default: 0
    description: SGP_CONF.SGP_LOW_VEL_SLOPE.
    min: 0
    max: 255

  tsgp-low-vel-thrs:
    type: int
    default: 4096
    description: TSGP_LOW_VEL_THRS (TSTEP units), StallGuard+ low velocity threshold.
    min: 0
    max: 1048575

  cool-cur-div:
    type: int
    default: 2
    description: COOLSTEPPLUS_CONF.COOL_CUR_DIV.
    min: 0
    max: 15

  load-filt-en:
    type: int
    default: 1
    enum:
      - 0
      - 1
    description: COOLSTEPPLUS_CONF.load_filt_en (reset value 1).

  cool-i:
    type: int
    default: 16
    description: COOLSTEPPLUS_PI_REG.COOLSTEP_I.
    min: 0
    max: 1023

  cool-p:
    type: int
    default: 128
    description: COOLSTEPPLUS_PI_REG.COOLSTEP_P.
    min: 0
    max: 4095

  cool-pi-off-speed:
    type: int
    default: 64
    description: COOLSTEPPLUS_PI_DOWN.COOL_PI_OFF_SPEED.
    min: 0
    max: 4095

  cool-pi-down-limit:
    type: int
    default: 128
    description: COOLSTEPPLUS_PI_DOWN.COOL_PI_DOWN_LIMIT.
    min: 0
    max: 4095

  cool-hi-generatoric-reserve:
    type: int
    default: 100
    description: COOLSTEPPLUS_RESERVE_CONF.COOL_HI_GENERATORIC_RESERVE.
    min: 0
    max: 255

  cool-low-generatoric-reserve:
    type: int
    default: 220
    description: COOLSTEPPLUS_RESERVE_CONF.COOL_LOW_GENERATORIC_RESERVE.
    min: 0
    max: 255

  cool-hi-load-reserve:
    type: int
    default: 50
    description: COOLSTEPPLUS_RESERVE_CONF.COOL_HI_LOAD_RESERVE.
    min: 0
    max: 255

  cool-low-load-reserve:
    type: int
    default: 150
    description: COOLSTEPPLUS_RESERVE_CONF.COOL_LOW_LOAD_RESERVE.
    min: 0
    max: 255

  udc-enable:
    type: boolean
    description: |
      UDC_CONF.udc_enable, enable uDcStep. Requires en-stealthchop and, on the TMC5262, the
      soft stop (en-softstop); both are checked at build time.

  udc-accel-thrs:
    type: int
    default: 12
    description: |
      UDC_CONF.ACCEL_THRS, must be lower than udc-decel-thrs. TMC5262 only: the TMC2262 has no
      ACCEL_THRS field (UDC_CONF[7:4] is reserved) and its binding blocks this property.
    min: 0
    max: 15

  udc-decel-thrs:
    type: int
    default: 14
    description: |
      UDC_CONF.DECEL_THRS, must be higher than udc-accel-thrs (TMC5262). On the TMC2262 it is
      the only threshold and may take any value of 0..15.
    min: 0
    max: 15

  tudcstep:
    type: int
    default: 0
    description: TUDCSTEP, uDcStep velocity threshold (TSTEP units).
    min: 0
    max: 1048575

  t-rcoil-meas:
    type: int
    default: 4096
    description: T_RCOIL_MEAS, time of the coil resistance measurement (reset value 0x1000).
    min: 0
    max: 1048575

  coil-inductance:
    type: int
    default: 0
    description: COIL_INDUCT.COIL_INDUCT, coil inductance value.
    min: 0
    max: 32767

  rcoil-manual:
    type: boolean
    description: |
      COIL_INDUCT.rcoil_manual, use the user coil resistances rcoil-user-a and rcoil-user-b
      instead of the measured ones.

  rcoil-user-a:
    type: int
    default: 0
    description: R_COIL_USER.R_COIL_USER_A, user coil resistance of phase A.
    min: 0
    max: 4095

  rcoil-user-b:
    type: int
    default: 0
    description: R_COIL_USER.R_COIL_USER_B, user coil resistance of phase B.
    min: 0
    max: 4095
```

## dts/bindings/stepper/adi/adi,tmc5262-ramp-ext.yaml
```yaml
# SPDX-FileCopyrightText: Copyright (c) 2026 Analog Devices, Inc.
# SPDX-License-Identifier: Apache-2.0

description: |
  Optional reference switch, virtual stop and position compare properties of the TMC5262 and
  TMC3241 (variants with a ramp generator). All properties are optional and default to the
  reset state of SW_MODE, VIRTUAL_STOP_L/R, X_COMPARE and X_COMPARE_REPEAT. They only have an
  effect while the ramp generator is the step source: setting one with step-source =
  "step-dir" fails the build. Not available on the TMC2262.

  The position compare event can be routed to DO0 or DO1 with the DO source "xcomp"
  (do0-sources / do1-sources).

properties:
  stop-l-enable:
    type: boolean
    description: SW_MODE.stop_l_enable, left reference switch stops the motion.

  stop-r-enable:
    type: boolean
    description: SW_MODE.stop_r_enable, right reference switch stops the motion.

  pol-stop-l:
    type: boolean
    description: SW_MODE.pol_stop_l, left switch is low active.

  pol-stop-r:
    type: boolean
    description: SW_MODE.pol_stop_r, right switch is low active.

  swap-lr:
    type: boolean
    description: SW_MODE.swap_lr, swap the left and right switch inputs.

  latch-l-active:
    type: boolean
    description: SW_MODE.latch_l_active, latch the position on the active edge of REFL.

  latch-l-inactive:
    type: boolean
    description: SW_MODE.latch_l_inactive, latch the position on the inactive edge of REFL.

  latch-r-active:
    type: boolean
    description: SW_MODE.latch_r_active, latch the position on the active edge of REFR.

  latch-r-inactive:
    type: boolean
    description: SW_MODE.latch_r_inactive, latch the position on the inactive edge of REFR.

  en-latch-encoder:
    type: boolean
    description: SW_MODE.en_latch_encoder, latch the encoder position as well.

  sg-stop:
    type: boolean
    description: SW_MODE.sg_stop, stop the motion on a StallGuard event.

  en-softstop:
    type: boolean
    description: SW_MODE.en_softstop, stop with the deceleration ramp instead of a hard stop.

  en-virtual-stop-l:
    type: boolean
    description: SW_MODE.en_virtual_stop_l, enable the left virtual stop.

  en-virtual-stop-r:
    type: boolean
    description: SW_MODE.en_virtual_stop_r, enable the right virtual stop.

  virtual-stop-enc:
    type: boolean
    description: SW_MODE.virtual_stop_enc, the virtual stops relate to X_ENC instead of XACTUAL.

  virtual-stop-l:
    type: int
    default: 0
    description: VIRTUAL_STOP_L, position of the left virtual stop.

  virtual-stop-r:
    type: int
    default: 0
    description: VIRTUAL_STOP_R, position of the right virtual stop.

  x-compare:
    type: int
    default: 0xFFFFFFFF
    description: X_COMPARE, compare position (reset value 0xFFFFFFFF).

  x-compare-repeat:
    type: int
    default: 0
    description: X_COMPARE_REPEAT, repeat distance of the position compare.
```
