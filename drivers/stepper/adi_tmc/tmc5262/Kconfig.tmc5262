## dts/bindings/stepper/adi/adi,tmc5262-sensor.yaml
```yaml
# SPDX-FileCopyrightText: Copyright (c) 2026 Analog Devices, Inc.
# SPDX-License-Identifier: Apache-2.0

description: |
  Sensor child of an ADI TMC5262, TMC2262 or TMC3241 node. Exposes the supply voltage
  (SENSOR_CHAN_VOLTAGE, VS) and the chip temperature (SENSOR_CHAN_DIE_TEMP) that the on-chip
  ADC measures, through the Zephyr sensor API.

  Example:

    tmc5262: tmc5262@0 {
        compatible = "adi,tmc5262";
        reg = <0>;
        ...
        tmc5262_sensor: sensor {
            compatible = "adi,tmc5262-sensor";
        };
    };

compatible: "adi,tmc5262-sensor"

include: sensor-device.yaml
```

## dts/bindings/stepper/adi/adi,tmc5262-stepper-ctrl.yaml
```yaml
# SPDX-FileCopyrightText: Copyright (c) 2026 Analog Devices, Inc.
# SPDX-License-Identifier: Apache-2.0

description: |
  Motion controller (stepper_ctrl API) child of an ADI TMC5262 or TMC3241 node, using the
  internal ramp generator. The parent must have step-source = "ramp-generator".

  Velocities are in register units (microsteps per 2^24 / fCLK), see the ramp generator
  conversion in the datasheet; with fCLK = 16 MHz one unit is 0.9537 microsteps/s and an
  acceleration unit is 116.4 microsteps/s^2. The Zephyr stepper_ctrl_configure_ramp()
  API takes microsteps/s and microsteps/s^2 instead.

  stepper_ctrl_configure_ramp() describes a trapezoid (maximum speed, acceleration,
  deceleration): it replaces a multi-phase profile of this node (v1, v2, a1, a2, d1, d2) by a
  single phase one (A1 = A2 = AMAX, D1 = D2 = DMAX, V1 = V2 = 0) and logs a warning if it does.
  VSTART, VSTOP and TZEROWAIT are kept. VMAX is limited to 0 .. 2^23 - 512 by the datasheet.

compatible: "adi,tmc5262-stepper-ctrl"

include:
  - name: adi,trinamic-ramp-generator.yaml
    property-allowlist:
      - vstart
      - a1
      - v1
      - amax
      - vmax
      - dmax
      - d1
      - vstop
      - tzerowait
      - a2
      - v2
      - d2

properties:
  vmax:
    required: true
  amax:
    required: true
  dmax:
    required: true
```

## dts/bindings/stepper/adi/adi,tmc5262-stepper-driver.yaml
```yaml
# SPDX-FileCopyrightText: Copyright (c) 2026 Analog Devices, Inc.
# SPDX-License-Identifier: Apache-2.0

description: |
  Stepper driver (stepper API) child of an ADI TMC5262, TMC2262 or TMC3241 node.

  Provides enable, disable, microstep resolution and events. For STEP/DIR operation
  reference this node from the "stepper-driver" property of a
  zephyr,gpio-step-dir-stepper-ctrl node: the controller then takes the step pulse
  width from step-width-ns and the active edge setting from the "dedge" property of
  the chip node.

compatible: "adi,tmc5262-stepper-driver"

include:
  - name: stepper-driver.yaml
    property-allowlist:
      - micro-step-res
  - name: step-dir-timing.yaml

properties:
  step-width-ns:
    default: 100
    description: |
      Minimum STEP pulse width in nanoseconds. The TMC5262 requires at least 100 ns
      for STEP high, STEP low and DIR to STEP setup.
```

## dts/bindings/stepper/adi/adi,tmc5262.yaml
```yaml
# SPDX-FileCopyrightText: Copyright (c) 2026 Analog Devices, Inc.
# SPDX-License-Identifier: Apache-2.0

description: |
  Analog Devices TMC5262 two-phase stepper motor controller and driver
  (SPI, 65 V, 4.25 A RMS, internal ramp generator).

  Example:

    &spi1 {
        tmc5262: tmc5262@0 {
            compatible = "adi,tmc5262";
            reg = <0>;
            spi-max-frequency = <DT_FREQ_M(4)>;
            sleepn-gpios = <&gpiob 4 GPIO_ACTIVE_HIGH>;
            drv-enn-gpios = <&gpiob 5 GPIO_ACTIVE_LOW>;
            current-range-ma = <4240>;
            irun = <127>;
            ihold = <32>;

            stepper_driver: stepper-driver {
                compatible = "adi,tmc5262-stepper-driver";
                micro-step-res = <256>;
            };

            stepper_ctrl: motion-controller {
                compatible = "adi,tmc5262-stepper-ctrl";
                vmax = <51200>;
                amax = <500>;
            };
        };
    };

compatible: "adi,tmc5262"

include:
  - name: spi-device.yaml
  - name: adi,tmc5262-base.yaml
  - name: adi,tmc5262-plus.yaml
  - name: adi,tmc5262-ramp-ext.yaml
  - name: adi,trinamic-ramp-generator.yaml
    property-allowlist:
      - tpwmthrs

properties:
  reg:
    required: true

  step-source:
    type: string
    default: ramp-generator
    enum:
      - ramp-generator
      - step-dir
    description: |
      Step source (GCONF.step_dir). "ramp-generator" uses the internal motion controller,
      "step-dir" uses STEP and DIR from a zephyr,gpio-step-dir-stepper-ctrl node. With
      step-dir, XACTUAL does not follow the external steps.

  current-range-ma:
    type: int
    default: 1060
    enum:
      - 1060
      - 2120
      - 3180
      - 4240
    description: |
      DRV_CONF.CURRENT_RANGE, full scale current in mA RMS. The ranges are 1.5, 3, 4.5 and
      6 A peak, which is 1060, 2120, 3180 and 4240 mA RMS.

  toff:
    type: int
    default: 5
    description: CHOPCONF.TOFF, off time and driver enable. 0 disables the driver.
    min: 0
    max: 15

  tbl:
    type: int
    default: 2
    description: CHOPCONF.TBL, comparator blank time (0 = ~1.25 us ... 3 = ~3.6 us).
    min: 0
    max: 3

  chm:
    type: boolean
    description: CHOPCONF.chm, constant off-time chopper instead of SpreadCycle.

  hstrt-tfd210:
    type: int
    default: 5
    description: CHOPCONF.HSTRT_TFD210, hysteresis start or fast decay time bits 2..0.
    min: 0
    max: 7

  hend-offset:
    type: int
    default: 4
    description: |
      CHOPCONF.HEND_OFFSET raw value 0..15 (hysteresis end or sine offset -3 .. +12).
    min: 0
    max: 15

  tpfd:
    type: int
    default: 4
    description: CHOPCONF.TPFD, passive fast decay time (0 = disabled).
    min: 0
    max: 15

  fd3:
    type: boolean
    description: CHOPCONF.fd3, MSB of the fast decay time with chm = 1.

  disfdcc:
    type: boolean
    description: CHOPCONF.disfdcc, fixed fast decay cycle with chm = 1.

  hard-stop-clr-cur-int:
    type: int
    default: 1
    enum:
      - 0
      - 1
    description: |
      SW_MODE.hard_stop_clr_cur_int, clear the current PI integrator upon a hard stop
      (reset value 1, recommended).

  en-stealthchop:
    type: boolean
    description: |
      GCONF.en_stealthchop, enable StealthChop+ (depending on tpwmthrs). Can only be
      changed at standstill at run time.

  pwm-freq:
    type: int
    default: 0
    description: PWMCONF.PWM_FREQ, 0 = 19.5 kHz ... 8 = 58.6 kHz.
    min: 0
    max: 8

  freewheel:
    type: int
    default: 0
    description: |
      PWMCONF.FREEWHEEL, standstill behavior at IHOLD = 0 (0 normal, 1 freewheeling,
      2 passive braking LS, 3 passive braking HS).
    min: 0
    max: 3

  ol-thrsh:
    type: int
    default: 0
    description: PWMCONF.OL_THRSH, StealthChop+ open load sensitivity.
    min: 0
    max: 3

  sd-on-meas-lo:
    type: int
    default: 14
    description: PWMCONF.SD_ON_MEAS_LO, must be lower than sd-on-meas-hi.
    min: 0
    max: 15

  sd-on-meas-hi:
    type: int
    default: 15
    description: PWMCONF.SD_ON_MEAS_HI, must be higher than sd-on-meas-lo.
    min: 0
    max: 15

  do0-sources:
    enum:
      - error
      - otpw
      - stall
      - index
      - step
      - dir
      - xcomp
      - ov
      - udcstep
      - ev-stop-ref
      - ev-stop-sg
      - ev-pos-reached
      - ev-n-deviation

  do1-sources:
    enum:
      - error
      - otpw
      - stall
      - index
      - step
      - dir
      - xcomp
      - ov
      - udcstep
      - ev-stop-ref
      - ev-stop-sg
      - ev-pos-reached
      - ev-n-deviation
```

## samples/drivers/stepper/tmc5262/Kconfig
```kconfig
# SPDX-FileCopyrightText: Copyright (c) 2026 Analog Devices, Inc.
# SPDX-License-Identifier: Apache-2.0

mainmenu "TMC5262 / TMC2262 / TMC3241 stepper sample"

config SAMPLE_MOVE_MICROSTEPS
	int "Microsteps to move"
	default 3200
	help
	  Number of microsteps of the positioning move (or of STEP/DIR pulses on the TMC2262).

config SAMPLE_STEP_INTERVAL_NS
	int "Interval between microsteps in ns (TMC2262 STEP/DIR pulses)"
	default 100000
	help
	  Microstep interval of the GPIO STEP/DIR pulses, 100000 ns = 10 kHz.

config SAMPLE_RAMP_INTERVAL_NS
	int "Interval between microsteps in ns (ramp generator)"
	default 19500
	help
	  Microstep interval that sets VMAX on the TMC5262 and TMC3241, about 51.3 kHz. It must
	  give a VMAX that is not below V1 and V2 of the overlay (53687 register units).

config SAMPLE_MOVE_TIMEOUT_MS
	int "Timeout for the move in ms"
	default 5000

source "Kconfig.zephyr"
```
