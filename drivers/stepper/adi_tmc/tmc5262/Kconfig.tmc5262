## drivers/stepper/adi_tmc/tmc5262/Kconfig.tmc5262
```kconfig
# SPDX-FileCopyrightText: Copyright The Zephyr Project Contributors
# SPDX-FileCopyrightText: Copyright (c) 2026 Analog Devices Inc.
# SPDX-License-Identifier: Apache-2.0

config STEPPER_ADI_TMC5262
	bool "Activate Trinamic TMC5262 stepper driver"
	depends on DT_HAS_ADI_TMC5262_ENABLED
	select STEPPER_ADI_TMC_SPI if $(dt_compat_on_bus,$(DT_COMPAT_ADI_TMC5262),spi)
	default y

if STEPPER_ADI_TMC5262

config STEPPER_ADI_TMC5262_STEPPER_CTRL
	bool "Activate Trinamic TMC5262 motion controller"
	depends on DT_HAS_ADI_TMC5262_STEPPER_CTRL_ENABLED
	depends on DT_HAS_ADI_TMC5262_STEPPER_DRIVER_ENABLED
	default y

config STEPPER_ADI_TMC5262_STEPPER_DRIVER
	bool "Activate Trinamic TMC5262 stepper driver"
	depends on DT_HAS_ADI_TMC5262_STEPPER_DRIVER_ENABLED
	default y

module = TMC5262
module-str = tmc5262
source "drivers/stepper/adi_tmc/Kconfig.tmc_rampgen_template"

endif # STEPPER_ADI_TMC5262
```

## dts/bindings/stepper/adi/adi,tmc5262-base.yaml
```yaml
# SPDX-FileCopyrightText: Copyright The Zephyr Project Contributors
# SPDX-FileCopyrightText: Copyright (c) 2026 Analog Devices Inc.
# SPDX-License-Identifier: Apache-2.0

description: |
  Common properties for the Analog Devices TMC5262 Stepper Motor Controller.

properties:
  clock-frequency:
    type: int
    required: true
    description: |
      The frequency of the clock signal driving the TMC5262 in Hz. Used for the
      real world velocity and acceleration conversions.

  sleepn-gpios:
    type: phandle-array
    required: true
    description: |
      Active-low sleep control pin (SLEEPN). Driven high to place the device in
      sleep during initialization and low to wake it.

  drvenn-gpios:
    type: phandle-array
    required: true
    description: |
      Active-low driver enable pin (DRVENN).

  motor-inductance:
    type: int
    default: 0
    description: Motor coil inductance value written to the COIL_INDUCT register.

  cool-cur-div:
    type: int
    default: 0
    description: CoolStep+ current divider (COOLSTEPPLUS_CONF.cool_cur_div).

  t-rcoil-meas:
    type: int
    default: 0
    description: Coil resistance measurement period written to T_RCOIL_MEAS.

  step-dir:
    type: boolean
    description: Enable STEP/DIR interface (GCONF.step_dir).

  ov-nn:
    type: boolean
    description: Enable OV_NN behaviour (GCONF.ov_nn).

  length-steppulse:
    type: int
    default: 0
    description: STEP pulse length in clock cycles (GCONF.length_steppulse, 0-15).

  direct-mode:
    type: boolean
    description: Enable direct coil current control (GCONF.direct_mode).

  stop-enable:
    type: boolean
    description: Enable the hard stop function (GCONF.stop_enable).

  small-hysteresis:
    type: boolean
    description: Use a smaller position comparison hysteresis (GCONF.small_hysteresis).

  shaft:
    type: boolean
    description: Invert the motor direction (GCONF.shaft).

  multistep-filt:
    type: boolean
    description: Enable step pulse filtering (GCONF.multistep_filt).

  en-stealthchop:
    type: boolean
    description: Enable StealthChop voltage PWM mode (GCONF.en_stealthchop).

  fast-standstill:
    type: boolean
    description: Enable fast standstill detection (GCONF.fast_standstill).
```

## dts/bindings/stepper/adi/adi,tmc5262-spi.yaml
```yaml
# SPDX-FileCopyrightText: Copyright The Zephyr Project Contributors
# SPDX-FileCopyrightText: Copyright (c) 2026 Analog Devices Inc.
# SPDX-License-Identifier: Apache-2.0

description: |
  Analog Devices TMC5262 Stepper Motor Controller (SPI mode)

compatible: "adi,tmc5262"

include: [spi-device.yaml, "adi,tmc5262-base.yaml"]

properties:
  reg:
    required: true

  diag0-gpios:
    type: phandle-array
    description: |
      Diagnostics output DIAG0 pin. Enables interrupt-based rampstat handling,
      allowing the driver to respond to motor events such as position reached or
      stall detection without polling.

examples:
  - |
    &spi0 {
        tmc5262: tmc5262@0 {
            compatible = "adi,tmc5262";
            reg = <0>;
            spi-max-frequency = <DT_FREQ_M(8)>;
            clock-frequency = <DT_FREQ_M(16)>;

            sleepn-gpios = <&gpio0 1 GPIO_ACTIVE_LOW>;
            drvenn-gpios = <&gpio0 2 GPIO_ACTIVE_LOW>;
            diag0-gpios = <&gpio0 0 GPIO_ACTIVE_HIGH>;

            en-stealthchop;

            tmc5262_stepper_driver: stepper-driver {
                compatible = "adi,tmc5262-stepper-driver";
                micro-step-res = <256>;
                stallguard2-threshold = <9>;
            };

            tmc5262_motion_controller: motion-controller {
                compatible = "adi,tmc5262-stepper-ctrl";

                activate-stallguard2;
                stallguard-threshold-velocity = <50000>;
                stallguard-velocity-check-interval-ms = <100>;

                vstart = <10>;
                a1 = <20>;
                v1 = <30>;
                a2 = <25>;
                v2 = <35>;
                d2 = <45>;
                d1 = <40>;
                vmax = <50>;
                amax = <60>;
                dmax = <70>;
                vstop = <10>;
                tzerowait = <80>;
                thigh = <90>;
                tcoolthrs = <100>;
                tpwmthrs = <110>;
                tpowerdown = <120>;
                ihold = <1>;
                irun = <2>;
                iholddelay = <3>;
            };
        };
    };
```

## dts/bindings/stepper/adi/adi,tmc5262-stepper-ctrl.yaml
```yaml
# SPDX-FileCopyrightText: Copyright The Zephyr Project Contributors
# SPDX-FileCopyrightText: Copyright (c) 2026 Analog Devices Inc.
# SPDX-License-Identifier: Apache-2.0

compatible: "adi,tmc5262-stepper-ctrl"

include:
  - name: adi,trinamic-stallguard.yaml
    property-allowlist:
      - activate-stallguard2
      - stallguard-threshold-velocity
      - stallguard-velocity-check-interval-ms
  - name: adi,trinamic-ramp-generator.yaml
    property-allowlist:
      - vstart
      - a1
      - v1
      - amax
      - vmax
      - dmax
      - d1
      - vstop
      - tzerowait
      - thigh
      - tcoolthrs
      - tpwmthrs
      - tpowerdown
      - ihold
      - irun
      - iholddelay

properties:
  a2:
    type: int
    default: 0
    description: Third acceleration between V1 and V2 in [usteps/ta^2] (unsigned).

  v2:
    type: int
    default: 0
    description: Second acceleration / deceleration phase threshold velocity in [usteps/t].

  d2:
    type: int
    default: 1
    description: Deceleration between V2 and V1 in [usteps/ta^2] (unsigned).
```

## dts/bindings/stepper/adi/adi,tmc5262-stepper-driver.yaml
```yaml
# SPDX-FileCopyrightText: Copyright The Zephyr Project Contributors
# SPDX-FileCopyrightText: Copyright (c) 2026 Analog Devices Inc.
# SPDX-License-Identifier: Apache-2.0

compatible: "adi,tmc5262-stepper-driver"

include:
  - name: stepper-driver.yaml
    property-allowlist:
      - micro-step-res
  - name: adi,trinamic-stallguard.yaml
    property-allowlist:
      - stallguard2-threshold
```
