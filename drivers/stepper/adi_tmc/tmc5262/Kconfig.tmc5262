## drivers/stepper/adi_tmc/tmc5262/Kconfig.tmc5262
```kconfig
# SPDX-FileCopyrightText: Copyright (c) 2026 Analog Devices, Inc.
# SPDX-License-Identifier: Apache-2.0

config STEPPER_ADI_TMC5262
	bool "ADI TMC5262 / TMC2262 / TMC3241 stepper driver"
	default y
	depends on DT_HAS_ADI_TMC5262_ENABLED || DT_HAS_ADI_TMC2262_ENABLED || \
			DT_HAS_ADI_TMC3241_ENABLED
	select GPIO
	select SPI
	select STEPPER_ADI_TMC_SPI
	select STEP_DIR_STEPPER
	help
	  Unified driver for the Analog Devices TMC5262 (two-phase controller and driver),
	  TMC2262 (two-phase driver, STEP/DIR) and TMC3241 (three-phase controller and
	  driver) stepper motor ICs, configured over SPI. The device variant is selected by
	  the devicetree compatible.

if STEPPER_ADI_TMC5262

config STEPPER_ADI_TMC5262_TMC5262
	bool
	default y
	depends on DT_HAS_ADI_TMC5262_ENABLED
	help
	  Variant data and code for the TMC5262.

config STEPPER_ADI_TMC5262_TMC2262
	bool
	default y
	depends on DT_HAS_ADI_TMC2262_ENABLED
	help
	  Variant data and code for the TMC2262.

config STEPPER_ADI_TMC5262_TMC3241
	bool
	default y
	depends on DT_HAS_ADI_TMC3241_ENABLED
	help
	  Variant data and code for the TMC3241.

config STEPPER_ADI_TMC5262_PLUS
	bool
	default y
	depends on DT_HAS_ADI_TMC5262_ENABLED || DT_HAS_ADI_TMC2262_ENABLED
	help
	  Extended API of the StealthChop+, StallGuard+, CoolStep+, uDcStep, coil measurement and
	  TriCoder features, which only the TMC5262 and TMC2262 have. Excluded from a build that
	  only has TMC3241 nodes (FR-VAR-005).

config STEPPER_ADI_TMC5262_STEPPER_DRIVER
	bool "TMC5262 stepper driver (stepper API)"
	default y
	depends on DT_HAS_ADI_TMC5262_STEPPER_DRIVER_ENABLED
	help
	  Enable, disable, microstep resolution and event API of the chip.

config STEPPER_ADI_TMC5262_SENSOR
	bool "TMC5262 supply voltage and temperature sensor"
	default y
	depends on DT_HAS_ADI_TMC5262_SENSOR_ENABLED
	select SENSOR
	help
	  Expose the supply voltage (SENSOR_CHAN_VOLTAGE) and the chip temperature
	  (SENSOR_CHAN_DIE_TEMP) of the on-chip ADC through the sensor API. The sensor is a child
	  node with compatible adi,tmc5262-sensor of the chip node.

config STEPPER_ADI_TMC5262_RAMP_GEN
	bool "TMC5262 ramp generator support"
	default y
	depends on DT_HAS_ADI_TMC5262_ENABLED || DT_HAS_ADI_TMC3241_ENABLED
	help
	  Enable the internal ramp generator (stepper_ctrl API) of the TMC5262 and TMC3241.

config STEPPER_ADI_TMC5262_STEPPER_CTRL
	bool "TMC5262 motion controller (stepper_ctrl API)"
	default y
	depends on STEPPER_ADI_TMC5262_RAMP_GEN && DT_HAS_ADI_TMC5262_STEPPER_CTRL_ENABLED
	help
	  Positioning and velocity mode on the internal ramp generator.

config STEPPER_ADI_TMC5262_INIT_PRIORITY
	int "TMC5262 chip init priority"
	default 85
	range 0 99
	help
	  Initialization priority of the TMC5262 chip device. It must be later than the SPI
	  and GPIO controllers and earlier than CONFIG_STEPPER_INIT_PRIORITY, which is used
	  by the stepper child devices.

config STEPPER_ADI_TMC5262_EVENT_POLL_INTERVAL_MS
	int "TMC5262 event polling interval in ms"
	default 100
	range 5 10000
	help
	  When neither DO0 nor DO1 is wired to an interrupt GPIO, motion, stall and fault
	  events are detected by polling the device at this interval while an event
	  callback is registered. With DO interrupt GPIOs the polling continues at ten times
	  this interval as a fallback, for events that have no DO source (for example the
	  stopped event).

module = STEPPER_ADI_TMC5262
module-str = TMC5262 stepper
parent-module = STEPPER
source "subsys/logging/Kconfig.template.log_config_inherit"

endif # STEPPER_ADI_TMC5262
```

## dts/bindings/stepper/adi/adi,tmc2262.yaml
```yaml
# SPDX-FileCopyrightText: Copyright (c) 2026 Analog Devices, Inc.
# SPDX-License-Identifier: Apache-2.0

description: |
  Analog Devices TMC2262 two-phase stepper motor driver (SPI configuration, STEP/DIR
  motion source, 65 V, 4 A RMS). The device has no internal ramp generator: use a
  zephyr,gpio-step-dir-stepper-ctrl node whose "stepper-driver" property points to the
  adi,tmc5262-stepper-driver child of this node.

  Example:

    &spi1 {
        tmc2262: tmc2262@0 {
            compatible = "adi,tmc2262";
            reg = <0>;
            spi-max-frequency = <DT_FREQ_M(4)>;
            sleepn-gpios = <&gpiob 4 GPIO_ACTIVE_HIGH>;
            drv-enn-gpios = <&gpiob 5 GPIO_ACTIVE_LOW>;
            current-range-ma = <3000>;

            tmc2262_driver: stepper-driver {
                compatible = "adi,tmc5262-stepper-driver";
                micro-step-res = <16>;
            };
        };
    };

    step_dir_ctrl: motion-controller {
        compatible = "zephyr,gpio-step-dir-stepper-ctrl";
        step-gpios = <&gpiob 0 GPIO_ACTIVE_HIGH>;
        dir-gpios = <&gpiob 1 GPIO_ACTIVE_HIGH>;
        stepper-driver = <&tmc2262_driver>;
    };

compatible: "adi,tmc2262"

include:
  - name: spi-device.yaml
  - name: adi,tmc5262-base.yaml
  - name: adi,tmc5262-plus.yaml
  - name: adi,trinamic-ramp-generator.yaml
    property-allowlist:
      - tpwmthrs

properties:
  reg:
    required: true

  current-range-ma:
    type: int
    default: 1500
    enum:
      - 1500
      - 3000
      - 4500
      - 6000
    description: |
      DRV_CONF.CURRENT_RANGE, full scale peak current in mA at RREF = 12 kOhm.

  toff:
    type: int
    default: 5
    description: CHOPCONF.TOFF, off time and driver enable. 0 disables the driver.
    min: 0
    max: 15

  tbl:
    type: int
    default: 2
    description: CHOPCONF.TBL, comparator blank time (0 = ~1.25 us ... 3 = ~3.6 us).
    min: 0
    max: 3

  chm:
    type: boolean
    description: CHOPCONF.chm, constant off-time chopper instead of SpreadCycle.

  hstrt-tfd210:
    type: int
    default: 5
    description: CHOPCONF.HSTRT_TFD210, hysteresis start or fast decay time bits 2..0.
    min: 0
    max: 7

  hend-offset:
    type: int
    default: 4
    description: |
      CHOPCONF.HEND_OFFSET raw value 0..15 (hysteresis end or sine offset -3 .. +12).
    min: 0
    max: 15

  tpfd:
    type: int
    default: 4
    description: CHOPCONF.TPFD, passive fast decay time (0 = disabled).
    min: 0
    max: 15

  fd3:
    type: boolean
    description: CHOPCONF.fd3, MSB of the fast decay time with chm = 1.

  en-stealthchop:
    type: boolean
    description: |
      GCONF.en_stealthchop, enable StealthChop+ (depending on tpwmthrs). Can only be
      changed at standstill at run time.

  pwm-freq:
    type: int
    default: 0
    description: PWMCONF.PWM_FREQ, 0 = 19.5 kHz ... 8 = 58.6 kHz.
    min: 0
    max: 8

  freewheel:
    type: int
    default: 0
    description: |
      PWMCONF.FREEWHEEL, standstill behavior at IHOLD = 0 (0 normal, 1 freewheeling,
      2 passive braking LS, 3 passive braking HS).
    min: 0
    max: 3

  ol-thrsh:
    type: int
    default: 0
    description: PWMCONF.OL_THRSH, StealthChop+ open load sensitivity.
    min: 0
    max: 3

  sd-on-meas-lo:
    type: int
    default: 14
    description: PWMCONF.SD_ON_MEAS_LO, must be lower than sd-on-meas-hi.
    min: 0
    max: 15

  sd-on-meas-hi:
    type: int
    default: 15
    description: PWMCONF.SD_ON_MEAS_HI, must be higher than sd-on-meas-lo.
    min: 0
    max: 15

  do0-sources:
    enum:
      - error
      - otpw
      - stall
      - index
      - ov
      - udcstep
      - ev-n-deviation

  do1-sources:
    enum:
      - error
      - otpw
      - stall
      - index
      - ov
      - udcstep
      - ev-n-deviation
```

## dts/bindings/stepper/adi/adi,tmc3241.yaml
```yaml
# SPDX-FileCopyrightText: Copyright (c) 2026 Analog Devices, Inc.
# SPDX-License-Identifier: Apache-2.0

description: |
  Analog Devices TMC3241 three-phase stepper motor controller and driver
  (SPI, 65 V, 4.2 A RMS, internal ramp generator).

  The microstep resolution of this device is expressed in electrical microsteps per
  quarter sine wave. One full step corresponds to 2/3 of the configured value.

  Example:

    &spi1 {
        tmc3241: tmc3241@0 {
            compatible = "adi,tmc3241";
            reg = <0>;
            spi-max-frequency = <DT_FREQ_M(4)>;
            sleepn-gpios = <&gpiob 4 GPIO_ACTIVE_HIGH>;
            drv-enn-gpios = <&gpiob 5 GPIO_ACTIVE_LOW>;
            current-range-ma = <4240>;

            stepper_driver: stepper-driver {
                compatible = "adi,tmc5262-stepper-driver";
                micro-step-res = <256>;
            };

            stepper_ctrl: motion-controller {
                compatible = "adi,tmc5262-stepper-ctrl";
                vmax = <51200>;
                amax = <500>;
                dmax = <500>;
            };
        };
    };

compatible: "adi,tmc3241"

include: [spi-device.yaml, "adi,tmc5262-base.yaml", "adi,tmc5262-ramp-ext.yaml"]

properties:
  reg:
    required: true

  step-source:
    type: string
    default: ramp-generator
    enum:
      - ramp-generator
      - step-dir
    description: |
      Step source (GCONF.threephase_mcc). "ramp-generator" uses the internal motion
      controller, "step-dir" uses STEP and DIR from a zephyr,gpio-step-dir-stepper-ctrl
      node.

  current-range-ma:
    type: int
    default: 1060
    enum:
      - 1060
      - 2120
      - 3180
      - 4240
    description: |
      DRV_CONF.CURRENT_RANGE, full scale current in mA RMS. The ranges are 1.5, 3, 4.5 and
      6 A peak, which is 1060, 2120, 3180 and 4240 mA RMS.

  toff:
    type: int
    default: 2
    description: CHOPCONF.TOFF, off time and driver enable. 0 disables the driver.
    min: 0
    max: 15

  tbl:
    type: int
    default: 2
    description: CHOPCONF.TBL, comparator blank time (0 = 16 ... 3 = 54 clocks).
    min: 0
    max: 3

  hyst:
    type: int
    default: 10
    description: |
      CHOPCONF.HYST, hysteresis value of the chopper (1/512 of this setting adds to the
      coil current setting).
    min: 0
    max: 63

  nosd:
    type: boolean
    description: CHOPCONF.nosd, skip the slow decay phase between chopper cycles.

  csync:
    type: boolean
    description: CHOPCONF.CSYNC, synchronize the chopper to the step frequency.

  sg-speed:
    type: boolean
    description: |
      CHOPCONF.sg_speed, StallGuard uses more filtering (for low motor velocities).
      Note: CHOPCONF.chm is reserved on this device and not configurable.

  do0-sources:
    enum:
      - error
      - otpw
      - stall
      - index
      - step
      - dir
      - xcomp
      - ov
      - ev-stop-ref
      - ev-stop-sg
      - ev-pos-reached
      - ev-n-deviation

  do1-sources:
    enum:
      - error
      - otpw
      - stall
      - index
      - step
      - dir
      - xcomp
      - ov
      - ev-stop-ref
      - ev-stop-sg
      - ev-pos-reached
      - ev-n-deviation
```
